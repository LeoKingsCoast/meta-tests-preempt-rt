## conf/layer.conf
```bitbake
# We have a conf and classes directory, add to BBPATH
BBPATH .= ":${LAYERDIR}"

# We have recipes-* directories, add to BBFILES
BBFILES += "${LAYERDIR}/recipes-*/*/*.bb \
            ${LAYERDIR}/recipes-*/*/*.bbappend"

BBFILE_COLLECTIONS += "meta-tests-preempt-rt"
BBFILE_PATTERN_meta-tests-preempt-rt = "^${LAYERDIR}/"
BBFILE_PRIORITY_meta-tests-preempt-rt = "6"

LAYERDEPENDS_meta-tests-preempt-rt = "core"
LAYERSERIES_COMPAT_meta-tests-preempt-rt = "scarthgap"
```
